## Kconfig
```kconfig
################################################################################
# Daemon configuration
################################################################################

menu "Daemon Setup"
  source "barbeque/bbque/Kconfig"
endmenu


################################################################################
# Policies
################################################################################

menu "Policies"
  source "barbeque/plugins/schedpol/Kconfig"
endmenu


################################################################################
# RTLib
################################################################################

menu "Run-Time Library (RTLib)"
  source "barbeque/rtlib/Kconfig"
endmenu # RTLib Configuration


################################################################################
# Programming Model
################################################################################

menu "Programming Model"

config BBQUE_TG_PROG_MODEL
  bool "Task-graph based programming model"
  default y

menu "Task-Graph Library (libtg)"
  depends on BBQUE_TG_PROG_MODEL
  source "barbeque/libtg/Kconfig"
endmenu # libtg

endmenu # Programming model


################################################################################
# Advanced Options
################################################################################

menu "Advanced Options"

config BBQUE_BUILD_DEBUG
  bool "Build DEBUG version"
  default n
  ---help---
  Build the BarbequeRTRM with DEBUGGING support enabled.

  This will produce a version of both the daemon and the RTLib with much more
  logging messages and debug symbols, which is suitable for debugging purposes.

menu "Recipe Loader"
  source "barbeque/plugins/rloader/Kconfig"
endmenu

config BBQUE_APP_PRIO_LEVELS
  int "Number of Priority Levels"
  default 5
  ---help---
  Applications are scheduled according to their priority which is a value
  ranging from 0 (highest priority) to a defined minimum value.

  Recipies define the priority of the corresponding Application.

config BBQUE_RESOURCE_MAX_NUM
  int "Number of Resources per Type"
  default 32
  ---help---
  The maximum number of resources per resource type.

  For example, the maximum number of processing elements (computing cores)
  available per processor.

config BBQUE_RESOURCE_PATH_PREFIX
   string "Resource binding prefix path"
   default "sys"
   ---help---
  The prefix (in string format) of the resource paths under which perform the
  matching w.r.t. the resource requests in the application recipes.
  For instance, value="sys" means that we will look for requests of CPUs or
  ACCELERATORs starting from resource registered under "sys." (e.g. "sys.cpu"
  or "sys.acc").

config BBQUE_SCHED_PROFILING
  bool "Scheduling Profiling"
  default n
  ---help---
  Enable the scheduling profiling support

  This will collect statistics about the resource allocation metrics (e.g.,
  mean and variance of the AWM from the scheduled applications, fairness
  index, etc...)

config BBQUE_BUILD_TESTS
  bool "Build the TEST suite"
  default n
  ---help---
  Build the BarbequeRTRM test suite.

  This will build also the set of regression tests used to verify framework
  stability during development.
  NOTE: this is an experimental and not completed feaure, leave un-selected is
  unsure.

config BBQUE_EM
  bool "Event Manager"
  default n
  ---help---
  Build the BarbequeRTRM with support for Event Management (EM).

  The Event Manager is a component for tracing internal BarbequeRTRM events.
  The events archive can be then plotted by using the Event Viewer tool.

  If unsure say no, this will disable all the EM related features.

config BBQUE_DM
  bool "Data Manager"
  default n
  ---help---
  Build the BarbequeRTRM with support for Data Management (DM).

  The Data Manager is a component to provide a publish/subscribe support
  for client applications that need to retrieve information about the status
  of the system, application and allocation.

  If your system does not need to provide information to third party clients
  leave it disable to avoid dangerous information leakage.

  NOTE: this is an experimental and not completed feature, leave un-selected if
  unsure.

endmenu # Advanced options
```

## bbque/Kconfig
```kconfig
menu "Platform Loader"

  choice
    prompt "Layout Parser"

    config BBQUE_PIL_LOADER
      bool "Platform Loader"
      ---help---
      The new platform loader for BarbequeRTRM Platform Layout files, that
      enables also multi-systems environment.

    config BBQUE_PIL_LEGACY
      bool "Legacy BPL Parser"
      ---help---
      The old parser for BarbequeRTRM Platform Layout files (under pil
      directory)
  endchoice

 # depends on BBQUE_PIL_LOADER
  source "barbeque/plugins/ploader/Kconfig"
endmenu


################################################################################
# Linux Resource Management
################################################################################

menu "Linux Resource Management"

  menu "Linux Control Groups"
  depends on !TARGET_EMULATED_HOST
  
    config BBQUE_LINUX_CG_SYSTEMD
      bool "Mount root hierarchy in systemd directory"
      default y
      depends on TARGET_LINUX
      depends on !TARGET_EMULATED_HOST
      ---help---
      Mount Control Groups into the /sys/fs/cgroup/cpu,cpuset,cpuacct,memory,net_cls
      directory.

    config BBQUE_LINUX_CG_CPU_EXCLUSIVE
      bool "CPU exclusive set"
      default y
      depends on TARGET_LINUX
      depends on !TARGET_EMULATED_HOST
      ---help---
      CPU cores managed by BarbequeRTRM are controlled in exclusive mode.
      Unselect this option if the system includes other CPU partitions with the
      exclusive mode option unset and an overlapped set of cores in the partition.
    
    config BBQUE_LINUX_CG_MEMORY
      bool "Memory controller"
      default n
      depends on TARGET_LINUX
      depends on !TARGET_EMULATED_HOST
      ---help---
      Enable the Control Groups memory controller for enforcing the memory
      assignment control.

    config BBQUE_LINUX_CG_BLKIO
      bool "Block I/O controller"
      default n
      depends on TARGET_LINUX
      depends on !TARGET_EMULATED_HOST
      ---help---
      Enable the Control Groups blkio controller for enforcing the I/O
      bandwidth assignment control.
    
    config BBQUE_LINUX_CG_NET_BANDWIDTH
      bool "Network bandwidth controller"
      default n
      depends on TARGET_LINUX
      depends on !TARGET_EMULATED_HOST
      ---help---
      Enable the Control Groups net_cls controller for enforcing the network
      bandwidth assignment control.
 
    config BBQUE_CGROUPS_DISTRIBUTED_ACTUATION
      bool "CGroups handled at RTLIb level"
      default n
      depends on TARGET_LINUX
      depends on !TARGET_EMULATED_HOST
      ---help---
      Control Groups are written by the RTLib rather than the Platform Proxy.
      Indeed, what is written into the CGroups is nonetheless decided by Barbeque.
  
  endmenu # Linux Control Groups

  config BBQUE_LINUX_PROC_MANAGER
    bool "Linux Process Management"
    default n
    ---help---
    Enables BarbequeRTRM to monitor the status of other processes running
    on the machine, and take actions (if the suitable policy has been selected)
  
  choice
    depends on !TARGET_EMULATED_HOST
    depends on BBQUE_PIL_LEGACY
    
    prompt "Memory locality"
      default BBQUE_MEMLOC_L3
  
    config BBQUE_MEMLOC_L3
      bool "L3 cache"
  
    config BBQUE_MEMLOC_L2
      bool "L2 cache"
  
    depends on !TARGET_EMULATED_HOST
    ---help---
    Select the memory locality that the BarbequeRTRM optimization policy should
    take into account to properly perform scheduling and resource allocation
    decisions.
    According to the option selected the resource manager can consider a CPU as
    an entity featuring one or more cores (processing elements), sharing a L3
    cache memory ("socket") or a L2 cache memory ("core").
  
  endchoice # Memory locality

endmenu # Linux Resource Management



################################################################################

menu "Power Management"
	source "barbeque/bbque/pm/Kconfig"

endmenu # Power Management

################################################################################
# Distributed Systems
################################################################################

menu "Distributed Systems"
  depends on BBQUE_PIL_LOADER

  config BBQUE_DIST_MODE
    bool "Distributed Mode"
    default n
    ---help---
    If enabled, it configures the BarbequeRTRM to control a distributed multi-node
    system.

  choice
    prompt "Distributed Configuration"
    depends on BBQUE_DIST_MODE

    config BBQUE_DIST_HIERARCHICAL
      bool "Hierarchical"
      ---help---
      Master/slave configuration. A master instance of the BarbequeRTRM is responsible
      of driving the decisional process of the instances running on the other system
      nodes.

    config BBQUE_DIST_FULLY
      bool "Fully Distributed"
      ---help
      No master instance expected. Each instance make autonomous choices, eventually
      negotiating the workload distribution among the other peer instances running
      on the other system nodes.

  endchoice

  source "barbeque/plugins/agent_proxy/Kconfig"

  source "barbeque/mpi/Kconfig"

endmenu # Distributed Systems

################################################################################
# Reliability Management
################################################################################

menu "Reliability Management"

  config BBQUE_RELIABILITY
    bool "Reliability Support"
    default n
    ---help---
    Add the support for checkpoint/restore and execution freezing.


  comment "Checkpoint/Restore (C/R) support"

  config BBQUE_CHECKPOINT_IMAGE_PATH
    depends on BBQUE_RELIABILITY
    string "Checkpoint dump image path"
    default "/tmp/bbque/dump"
    ---help---
    The path under which to store the images of the processes dump
    after a checkpoint.

  config BBQUE_PERIODIC_CHECKPOINT
    depends on BBQUE_RELIABILITY
    default n
    bool "Periodic checkpoint"
    ---help---
    If enabled it leads the BarbequeRTRM to perform periodic checkpoint of the
    managed applications and processes.

  config BBQUE_CHECKPOINT_PERIOD_LENGTH
    depends on BBQUE_PERIODIC_CHECKPOINT
    default 30000
    int "Length of the checkpoint period (ms)"
    ---help---
    The path under which to store the images of the processes dump
    after a checkpoint.

  comment "Linux system-specific support"

  config BBQUE_CRIU_BINARY_PATH
    depends on BBQUE_RELIABILITY
    string "CRIU binary path"
    default "/usr/sbin/criu"
    ---help---
    The path under which the CRIU executable is located.

  config BBQUE_FREEZER_PATH
    depends on BBQUE_RELIABILITY
    string "Freezer interfaces path"
    default "/sys/fs/cgroup/freezer/bbque"
    ---help---
    The path under which freezer interfaces are located.

  comment "Other target-specific supports"

  config BBQUE_CR_FPGA
    depends on BBQUE_RELIABILITY
    depends on TARGET_LINUX_RECIPE
    bool "FPGA accelerators C/R"
    ---help---
    Checkpoint/Restore support for FPGA accelerators of the RECIPE platforms.

  config BBQUE_LIBACRE_PATH
    depends on BBQUE_CR_FPGA
    string "ACRE library installation path"
    ---help---
    Installation path of the libacre.

endmenu #Reliability
```

## config/templates/cpp/Kconfig
```kconfig
config SAMPLES_APPTYPE_MYAPP
  bool "MyApp"
  default n
  select BOSP_SAMPLES_APPTYPE
  ---help---
  Build the MyApp application.
  
  Insert here a description of this application.

  If unsure, say No to this option.
```

## config/templates/python/Kconfig
```kconfig
config SAMPLES_APPTYPE_MYAPP
  bool "MyApp"
  default n
  select BOSP_SAMPLES_APPTYPE
  select BBQUE_BINDINGS_PYTHON
  ---help---
  Build the MyApp Python-AEM application. 
```

## plugins/rloader/Kconfig
```kconfig
choice
  prompt "Default recipe loader"
  default BBQUE_RLOADER_DEFAULT_RXML

  config BBQUE_RLOADER_DEFAULT_RXML
    bool "RXML"
    select BBQUE_RLOADER_RXML
##NP

endchoice

source barbeque/plugins/rloader/rxml/Kconfig
```

## plugins/schedpol/Kconfig
```kconfig
menu "Advanced Options"

config BBQUE_SP_PARALLEL
  bool "Policy Parallel Execution"
  default y
  ---help---
  If selected enable the multi-threaded/parallel execution of the scheduling policy.
  This in case of policy implementation supporting sequential and parallel
  execution flow. It can be useful to disable this option for debug purpose.

  Select this option if you plan to run the BarbequeRTRM daemon on a multi-core
  host machine.

config BBQUE_RM_OPT_EXC_START_DEFER_MS
  int "Wait time (ms) before policy activation, on application start"
  default 50
  ---help---
  Some milliseconds after an application starts, barbeque triggers
  an optimization

config BBQUE_RM_OPT_EXC_STOP_DEFER_MS
  int "Wait time (ms) before policy activation, on application termination"
  default 50
  ---help---
  Some milliseconds after an application terminates, barbeque triggers
  an optimization

config BBQUE_RM_OPT_REQUEST_DEFER_MS
  int "Wait time (ms) before policy activation, on application request"
  default 50
  ---help---
  When an application asks barbeque for a new resource allocation,
  barbeque waits some milliseconds in order to aggregate requests from
  other apps as well (if any).


#config BBQUE_SP_COWS_BINDING
#  bool "Co-scheduling Workloads (COWS) binding"
#  depends on !BBQUE_OPENCL
#  default n
#  ---help---
#  Enable this option only if the recipes feature information about some
#  performance counters based statistics. and the scheduling policy implements
#  the support to exploit such information. This potentially leads to a more
#  effective binding (i.e. selection of the resource domain of the AWM) in order
#  to establish whether it is better to co-schedule applications on the same
#  resource binding domain (e.g., CPU node) or spread them among different
#  domains.
#
#  If unsure, say N
#
endmenu #Advanced Options


choice
  prompt "Default scheduling policy"
  config BBQUE_SCHEDPOL_DEFAULT_TEST
    bool "Test"
    depends on BBQUE_SCHEDPOL_TEST

  config BBQUE_SCHEDPOL_DEFAULT_RANDOM
    depends on BBQUE_SCHEDPOL_RANDOM
    bool "Random"

  config BBQUE_SCHEDPOL_DEFAULT_TEMPURA
    depends on BBQUE_SCHEDPOL_TEMPURA
    bool "Tempura"

  config BBQUE_SCHEDPOL_DEFAULT_TEMPBALANCE
    depends on BBQUE_SCHEDPOL_TEMPBALANCE
    bool "TempBalance"

  config BBQUE_SCHEDPOL_DEFAULT_PERDETEMP
    depends on BBQUE_SCHEDPOL_PERDETEMP
    bool "Perdetemp"

  config BBQUE_SCHEDPOL_DEFAULT_CONTREX
    depends on BBQUE_SCHEDPOL_CONTREX
    bool "Contrex"

  config BBQUE_SCHEDPOL_DEFAULT_CLOVES
    depends on BBQUE_SCHEDPOL_CLOVES
    bool "Cloves"

  config BBQUE_SCHEDPOL_DEFAULT_MANGA
    depends on TARGET_LINUX_MANGO
    depends on BBQUE_SCHEDPOL_MANGA
    bool "ManGA"

  config BBQUE_SCHEDPOL_DEFAULT_MANGAV2
    depends on TARGET_LINUX_MANGO
    depends on BBQUE_SCHEDPOL_MANGAV2
    bool "ManGAv2"

  config BBQUE_SCHEDPOL_DEFAULT_THROTTLE
    depends on BBQUE_SCHEDPOL_THROTTLE
    bool "Throttle"

endchoice

source barbeque/plugins/schedpol/random/Kconfig
source barbeque/plugins/schedpol/test/Kconfig
source barbeque/plugins/schedpol/tempura/Kconfig
source barbeque/plugins/schedpol/tempbalance/Kconfig
source barbeque/plugins/schedpol/perdetemp/Kconfig
source barbeque/plugins/schedpol/contrex/Kconfig
source barbeque/plugins/schedpol/cloves/Kconfig
source barbeque/plugins/schedpol/manga/Kconfig
source barbeque/plugins/schedpol/mangav2/Kconfig
source barbeque/plugins/schedpol/throttle/Kconfig
```
