## plugins/schedpol/adaptive_cpu/Kconfig
```kconfig
config BBQUE_SCHEDPOL_ADAPTIVECPU
  bool "AdaptiveCPU"
  default n
  depends on TARGET_NO_ACCELERATION
  ---help---
  The core of the policy is a configurable PID controller, assigning
  CPU quota to active applications on the basis of the amount actually
  used by the application. Suitable for periodic or performance goal
  driven executions.
```

## plugins/schedpol/cloves/Kconfig
```kconfig
config BBQUE_SCHEDPOL_CLOVES
  bool "Cloves"
  depends on TARGET_OPENCL
  depends on !TARGET_EMULATED_HOST
  select BBQUE_PM_AMD
  select BBQUE_PM_CPU
  default n
  ---help---
  Description...
```

## plugins/schedpol/contrex/Kconfig
```kconfig
config BBQUE_SCHEDPOL_CONTREX
  depends on !TARGET_SIMULATED_PLATFORM
  depends on !TARGET_LINUX_MANGO
  bool "Contrex"
  default n
  ---help---
  This policy is for mixed-criticaly embedded systems, featuring
  a multi-core CPU.
  The policy labels the prio=0 applications has 'critical', while all the
  other priority levels are considered 'non-critical'.
  The available CPU quota is distributed among the applications reserving
  for each critical one 1 core (100% quota) at most. The remaining quota
  is then evenly distributed among non-critical applications.
```

## plugins/schedpol/dynamicrandom/Kconfig
```kconfig
config BBQUE_SCHEDPOL_DYNAMICRANDOM
  bool "DynamicRandom (CPU)"
  default n
  depends on TARGET_NO_ACCELERATION
  ---help---
  This policy allocates resources dynamically and randomly according to a 
  chosen distribution and to the available resources among applications. 
  The policy is dynamic because of its ability to create a Working Mode
  on-the-fly.
```

## plugins/schedpol/manga/Kconfig
```kconfig
config BBQUE_SCHEDPOL_MANGA
  depends on TARGET_LINUX_MANGO
  bool "ManGA"
  default y
  ---help---
  MANGO platforms: for each application task, select the first available
  computing unit.
```

## plugins/schedpol/mangav2/Kconfig
```kconfig
config BBQUE_SCHEDPOL_MANGAV2
  bool "ManGAv2"
  depends on TARGET_LINUX_MANGO
  default y
  ---help---
  MANGO platforms: apply the resource mapping option, following the
  insertion order of the application's recipe file.
```

## plugins/schedpol/perdetemp/Kconfig
```kconfig
config BBQUE_SCHEDPOL_PERDETEMP
  bool "Perdetemp"
  depends on !TARGET_SIMULATED_PLATFORM
  depends on !TARGET_LINUX_MANGO
  depends on BBQUE_PM_CPU
  select BBQUE_RTLIB_CGROUPS_SUPPORT
  default n
  ---help---
  Multi-binding domain resource allocation policy, featuring recipe-less AWM
  creation and online characterization through performance counters and
  goal gap assertion. Binding is chosen taking into account PERformance,
  DEgradation and TEMPerature.
```

## plugins/schedpol/random/Kconfig
```kconfig
config BBQUE_SCHEDPOL_RANDOM
  bool "Random"
  depends on !TARGET_LINUX_MANGO
  default n
  ---help---
  Single binding domain (e.g. single multi-core CPU) resource allocation
  policy, featuring a random choice of AWM and resource binding.
```

## plugins/schedpol/tempbalance/Kconfig
```kconfig
config BBQUE_SCHEDPOL_TEMPBALANCE
  bool "TempBalance"
  depends on !TARGET_SIMULATED_PLATFORM
  depends on !TARGET_LINUX_MANGO
  default y
  ---help---
  This simple policy assigns an amount of CPU quota / number of CPU cores to
  the active applications which is proportional to the application priority level.
  This means that priority 0 applications will receive a CPU partition bigger
  than application featuring lower priority values.
  If the CPU Power Management support has been enabled, the policy will also consider
  the temperature of the cores, in order to perform a mapping that could balance
  the thermal profile.
```

## plugins/schedpol/tempura/Kconfig
```kconfig
config BBQUE_SCHEDPOL_TEMPURA
  bool "Tempura"
  default n
  depends on !TARGET_EMULATED_HOST
  depends on !TARGET_LINUX_MANGO
  select BBQUE_PM
  select BBQUE_PM_CPU
  ---help---
  The policy sets an upper bound of CPU quota, given a temperature constraint
  (maximum CPU temperature allowed) and optionally and energy budget constraint.
  The latter is derived from the need of guaranteeing that, while battery-powered,
  the system will stay on for a target amount of time.

  The CPU upper bound then is partitioned among the active applications in a way
  proportional to the priority level.
```

## plugins/schedpol/test/Kconfig
```kconfig
config BBQUE_SCHEDPOL_TEST
  bool "Test"
  default y
  ---help---
  This is a policy for testing purpose. This means that the framework
  developer can directly put the hands inside to change internal function
  calls arguments in order to test the correct behaviour of the BarbequeRTRM
  internals involved.
```

## plugins/schedpol/throttle/Kconfig
```kconfig
config BBQUE_SCHEDPOL_THROTTLE
  bool "Throttle"
  default n
  depends on TARGET_ARM_BIG_LITTLE
  ---help---
  Policy to manage Android application performance/power constraints.
```

## rtlib/Kconfig
```kconfig
choice
  prompt "RPC Channel"

  config BBQUE_RPC_FIFO
    bool "FIFO based"
    ---help---
    Use the FIFO based RPC channel
    
  config BBQUE_RPC_PB_FIFO
    bool "FIFO based with Protocol Buffers"
    ---help---
    Use the Google Protocol Buffers and FIFO based RPC channel
endchoice


################################################################################
# Bindings
################################################################################

menu "Bindings"
  source "barbeque/rtlib/bindings/Kconfig"
endmenu # Bindings Configuration


################################################################################

config BBQUE_RPC_TIMEOUT
  int "RPC Channel Timeout"
  default 5000
  ---help---
  The amount of time (in seconds) after which a not responding application
  must be considered disabled.

config BBQUE_RTLIB_APP_NAME_LENGTH
  int "Application Name Length"
  default 32
  ---help---
  The length of the string representing the name of the application

config BBQUE_RTLIB_MONITORS
  bool "Monitor library (AS-RTM)"
  default n
  ---help---
  Monitor library (also called ARGO). It consists of a framework to manage the
  reconfiguration space of an application including several paramenters and
  a wide range of possible values.

config BBQUE_RTLIB_PERF_SUPPORT
  bool "Performance Counters Profiling Support"
  depends on TARGET_LINUX
  default y
  ---help---
  Build the Run-Time Library (RTLib) with support for Performance Counters.
  These counters allows an application, which has been integrated with the
  RTLib, to collect transparently a set of profiling information related
  to the run-time execution.

  This option is useful to port easily the RTLib on platforms not supporting
  performance counters, such as some Android devices with older kernels.

config BBQUE_RTLIB_CGROUPS_SUPPORT
  bool "CGroups Profiling Support"
  depends on TARGET_LINUX
  depends on !BBQUE_TEST_PLATFORM_DATA
  default n if BBQUE_TEST_PLATFORM_DATA
  default y
  ---help---
  Build the Run-Time Library (RTLib) with support for CGroups.
  This framework allows an application, which has been integrated with the
  RTLib, to collect transparently a set of profiling information related
  to the run-time execution.

  This option is useful to port easily the RTLib on platforms not supporting
  or using CGroups for run-time resources management, such as some Android
  devices.

config BBQUE_RTLIB_UNMANAGED_SUPPORT
  bool "Unmanaged Applications Support"
  depends on TARGET_LINUX
  default y
  ---help---
  Build the Run-Time Library (RTLib) with support for UNMANAGED applications.

  An application running in UNMANAGED mode is not controlled by the BarbequRTRM and
  its automatically configured by the RTLib to run in AWM 0 (by default).
  Once this support is enabled, an application could be executed un UNMANAGED mode
  by setting the "U" flag in the BBQUE_RTLIB_OPTS environment variable.
  Such flag could be followed by the ID of the AWM the application should be configured
  to run into, for example:
    BBQUE_RTLIB_OPTS="U3"
  will run the application in AWM 3.

  This option is useful to run applications without BarbequeRTRM control, for example to
  easily support Design Space Exploration (DSE) or the initial development stages of
  a new application.

  Say NO to this option if unsure.

menu "Performance API Configuration"

config BBQUE_RTLIB_RTPROF_REARM_TIME_MS
  int "Runtime Profiles Forwarding Rearm Time [ms]"
  default 1000
  ---help---
  Each time the Runtime Library forwards a runtime profile to the BarbequeRTRM,
  the forwarding is inhibited to avoid high forwarding rates. By changing
  this option, the inhibition time can be changed. Note that the value is
  expressed in milliseconds.

config BBQUE_RTLIB_RTPROF_WAIT_FOR_SYNC_MS
  int "Runtime Profiles Forwarding Wait For Sync Time [ms]"
  default 5000
  ---help---
  Each time the Runtime Library forwards a runtime profile to the BarbequeRTRM,
  the forwarding is inhibited until the BarbequeRTRM modifies the resource allocation.
  If the BarbequeRTRM does not change the allocation for a certain period of time,
  the Runtime Library become once again able to forward runtime profiles.

endmenu # Performance

comment "Advanced Options"

config BBQUE_YM_SYNC_FORCE
  bool "Synchronization Point forcing"
  default n
  ---help---
  Enable the Sync Point forcing via Synchronization Manager and RTLib.

  By selecting this option, the Synchronization Manager (YM) enforce EXCs
  reconfiguration to be aligned with the synchronization latency defined by
  applications being reconfigured.
  The synchronization latency is the time delay required by an application to
  be in a synchronization point, i.e. complete the current run and being ready
  to start a new one.

  In general this option could be keept disabled, since it is mandatory just
  on few specific platforms and programming paradigms combinations.
  Specifically, it should be explicitly enabled just when a resource
  contention treat could be expected on a specific target platform or
  programming paradigm.

  NOTE: disabling Sync Point Enforcing is corrently not completely safe and
        could lead to a reconfiguration miss for some applications.
        Use this feature at your own risk.

  If unsure, select N

config BBQUE_YP_SASB_ASYNC
  bool "Parallel Re-configurations"
  default n if TARGET_ANDROID
  default y
  ---help---
  Build the SASM policy with support for asynchronous protocol calls.

  By selecting this option, the synchronization protocol is executed with
  asynchronous calls which means that the interaction with applications to be
  re-configured is parallelized, i.e. each protocol requets is managed by a
  dedicated thread and all them runs in parallel.

  Select this option if you plan to run the BarbequeRTRM daemon on a multi-core
  host machine and with a average high number of concurrent applications.

  If unsure, select Y. Select N for Android targets.
```

## rtlib/bindings/Kconfig
```kconfig
config BBQUE_BINDINGS_PYTHON
  depends on TARGET_LINUX_NATIVE
  bool "Python wrapper"
  select EXTERNAL_PYBIND11
  default n
  ---help---
  Build the module to provide the Python wrapper of the RTLib

config BBQUE_BINDINGS_JAVA
  bool "Java wrapper"
  default n
  ---help---
  Build the module to provide the Java wrapper of the RTLib

config BBQUE_BINDINGS_ANDROID
  bool "Android API"
  depends on BBQUE_BINDINGS_JAVA
  depends on TARGET_ANDROID
  default y
  ---help---
  Build the module to provide the Android Archive API of the RTLib
```
